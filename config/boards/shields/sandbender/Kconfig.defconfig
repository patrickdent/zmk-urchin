## config/boards/shields/sandbender/Kconfig.defconfig
```kconfig
# Copyright (c) 2022 Duccio Breschi
# SPDX-License-Identifier: MIT

if SHIELD_SANDBENDER_LEFT

config ZMK_KEYBOARD_NAME
    default "sandbender-02"

config ZMK_SPLIT_ROLE_CENTRAL
    default y

endif

if SHIELD_SANDBENDER_LEFT || SHIELD_SANDBENDER_RIGHT
config ZMK_SPLIT
    default y
endif
```

## config/boards/shields/sandbender/Kconfig.shield
```kconfig
# Copyright (c) 2022 Duccio Breschi
# SPDX-License-Identifier: MIT

config SHIELD_SANDBENDER_LEFT
    def_bool $(shields_list_contains,sandbender_left)

config SHIELD_SANDBENDER_RIGHT
    def_bool $(shields_list_contains,sandbender_right)
```
